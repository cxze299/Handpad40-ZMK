## boards/arm/e73_handpad40/Kconfig.board
```kconfig
config BOARD_E73_HANDPAD40
    bool "E73 handpad40"
    depends on SOC_NRF52840_QIAA
```

## boards/arm/e73_handpad40/Kconfig.defconfig
```kconfig
if BOARD_E73_HANDPAD40

config BOARD
    default "e73_handpad40"

if USB_DEVICE_STACK

config USB_NRFX
    default y

endif # USB_DEVICE_STACK

config BT_CTLR
    default BT

endif # BOARD_E73_HANDPAD40
```

## boards/arm/e73_handpad40/e73_handpad40_defconfig
```kconfig
CONFIG_SOC_SERIES_NRF52X=y
CONFIG_SOC_NRF52840_QIAA=y
CONFIG_BOARD_E73_HANDPAD40=y

CONFIG_ARM_MPU=y
CONFIG_GPIO=y
CONFIG_USE_DT_CODE_PARTITION=y

# E73 exposes XL1/XL2 pins, and this keyboard uses P0.26 as COL1.
# Use the internal RC LFCLK instead of reserving XL1/XL2 for a 32.768 kHz crystal.
CONFIG_CLOCK_CONTROL_NRF_K32SRC_RC=y
CONFIG_CLOCK_CONTROL_NRF_K32SRC_500PPM=y

CONFIG_FLASH=y
CONFIG_FLASH_PAGE_LAYOUT=y
CONFIG_FLASH_MAP=y
CONFIG_NVS=y
CONFIG_SETTINGS_NVS=y

CONFIG_ZMK_USB=y
CONFIG_ZMK_BLE=y
```

## boards/arm/e73_handpad40_uf2/Kconfig.board
```kconfig
config BOARD_E73_HANDPAD40_UF2
    bool "E73 Handpad40 UF2"
    depends on SOC_NRF52840_QIAA
```

## boards/arm/e73_handpad40_uf2/Kconfig.defconfig
```kconfig
if BOARD_E73_HANDPAD40_UF2

config BOARD
    default "e73_handpad40_uf2"

endif # BOARD_E73_HANDPAD40_UF2
```

## boards/arm/e73_handpad40_uf2/e73_handpad40_uf2_defconfig
```kconfig
CONFIG_SOC_SERIES_NRF52X=y
CONFIG_SOC_NRF52840_QIAA=y
CONFIG_BOARD_E73_HANDPAD40_UF2=y

CONFIG_ARM_MPU=y
CONFIG_GPIO=y
CONFIG_USE_DT_CODE_PARTITION=y

# This board uses an Adafruit/Nordic pca10056 UF2 bootloader with S140.
# The application must live after the bootloader + SoftDevice region.
CONFIG_BUILD_OUTPUT_UF2=y
CONFIG_BUILD_OUTPUT_UF2_FAMILY_ID="0x239A0029"

# E73 exposes XL1/XL2 pins, and this keyboard uses P0.26 as COL1.
# Use the internal RC LFCLK instead of reserving XL1/XL2 for a 32.768 kHz crystal.
CONFIG_CLOCK_CONTROL_NRF_K32SRC_RC=y
CONFIG_CLOCK_CONTROL_NRF_K32SRC_500PPM=y

CONFIG_FLASH=y
CONFIG_FLASH_PAGE_LAYOUT=y
CONFIG_FLASH_MAP=y
CONFIG_NVS=y
CONFIG_SETTINGS_NVS=y

CONFIG_ZMK_USB=y
```
